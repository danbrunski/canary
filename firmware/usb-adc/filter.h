/*
 * The decimation chain, free of hardware so the host test
 * (tests/test_usb_adc_firmware_filter.py) compiles the same code:
 *
 *     ADC conversions --sum R1--> stage 1 --FIR, keep every R2th--> output
 *
 * Coefficients and rates are fir_taps.h, generated by design_fir.py.
 */
#ifndef FILTER_H
#define FILTER_H

#include <stdint.h>

#include "fir_taps.h"

typedef struct {
    uint32_t acc1;            /* stage-1 running sum */
    uint32_t n1;              /* conversions in acc1 */
    uint32_t line[NUM_TAPS];  /* stage-1 sums, newest at `head` */
    uint32_t head;
    uint32_t filled;          /* stage-1 sums seen, saturating at NUM_TAPS */
    uint32_t n2;              /* stage-1 sums since the last output */
} filter_t;

/* Feed one 12-bit conversion. Returns 1 and sets *out (12-bit counts,
 * rounded) when an output sample is ready; 0 otherwise. Nothing is output
 * until the delay line has filled, so the first sample is already settled. */
static inline int filter_push(filter_t *f, uint16_t conversion, uint32_t *out) {
    f->acc1 += conversion;
    if (++f->n1 < R1) {
        return 0;
    }
    f->head = (f->head + 1u) % NUM_TAPS;
    f->line[f->head] = f->acc1;
    f->acc1 = 0;
    f->n1 = 0;
    if (f->filled < NUM_TAPS) {
        f->filled++;
    }
    if (++f->n2 < R2) {
        return 0;
    }
    f->n2 = 0;
    if (f->filled < NUM_TAPS) {
        return 0;
    }
    int64_t acc = 0;
    uint32_t idx = f->head;
    for (uint32_t k = 0; k < NUM_TAPS; k++) {
        acc += (int64_t)FIR_TAPS[k] * (int64_t)f->line[idx];
        idx = idx ? idx - 1u : NUM_TAPS - 1u;
    }
    /* Taps sum to 32768 and each stage-1 value is a sum of R1 conversions.
     * The shift is inline; a 64-bit divide would need libgcc, which this
     * bare-metal build does not link. After it the value fits 32 bits
     * (<= 4095 x R1 plus ringing), and the Cortex-M3 divides that in hardware. */
    if (acc <= 0) {
        *out = 0;
        return 1;
    }
    uint32_t sum = (uint32_t)((acc + (1 << 14)) >> 15);
    uint32_t counts = (sum + R1 / 2u) / R1;
    *out = counts > 4095u ? 4095u : counts;
    return 1;
}

#endif
